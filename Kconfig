## Kconfig
```kconfig
config SPARD_WLAN_SUPPORT
	bool "Unisoc wireless Support"
	select AML_WIFI_DEVICE_UWE5621  if SPARD_WLAN_SUPPORT
	default m
	help
	  This is support for spreadtrum wireless chip.

if SPARD_WLAN_SUPPORT
#source "drivers/net/wireless/uwe5621ds-aml/unisocwcn/Kconfig"
source "drivers/net/wireless/uwe5621ds-aml/unisocwifi/Kconfig"
@source "drivers/net/wireless/uwe5621ds-aml/tty-sdio/Kconfig"
endif
```
